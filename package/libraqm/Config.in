## package/libraqm/Config.in
```kconfig
config BR2_PACKAGE_LIBRAQM
	bool "libraqm"
	depends on BR2_INSTALL_LIBSTDCPP # harfbuzz
	depends on BR2_TOOLCHAIN_HAS_SYNC_4 # harfbuzz
	depends on BR2_TOOLCHAIN_GCC_AT_LEAST_4_9 # harfbuzz
	select BR2_PACKAGE_FREETYPE
	select BR2_PACKAGE_HARFBUZZ
	select BR2_PACKAGE_LIBFRIBIDI
	help
	  Raqm is a small library that encapsulates the logic for
	  complex text layout and provides a convenient API.

	  It currently provides bidirectional text support (using
	  FriBiDi), shaping (using HarfBuzz), and proper script
	  itemization. As a result, Raqm can support most writing
	  systems covered by Unicode.

	  https://github.com/HOST-Oman/libraqm

comment "libraqm needs a toolchain w/ C++, gcc >= 4.9"
	depends on BR2_TOOLCHAIN_HAS_SYNC_4
	depends on !BR2_INSTALL_LIBSTDCPP || \
		!BR2_TOOLCHAIN_GCC_AT_LEAST_4_9
```
